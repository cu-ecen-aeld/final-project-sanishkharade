## base_external/Config.in
```kconfig
source "$BR2_EXTERNAL_project_base_PATH/package/aesd-assignments/Config.in"
source "$BR2_EXTERNAL_project_base_PATH/package/ldd/Config.in"
source "$BR2_EXTERNAL_project_base_PATH/package/aesd-char-device/Config.in"
source "$BR2_EXTERNAL_project_base_PATH/package/aesd-uart-driver/Config.in"
source "$BR2_EXTERNAL_project_base_PATH/package/aesd-socket/Config.in"
```

## base_external/package/aesd-char-device/Config.in
```kconfig
config BR2_PACKAGE_AESD_CHAR_DEVICE
	bool "aesd-char-device"
	help
	  Includes the aesd char device in the kernel image.
	  Used to understand buildroot external trees and package builds.
```

## base_external/package/aesd-gpio/Config.in
```kconfig
config BR2_PACKAGE_AESD_GPIO
	bool "aesd-gpio"
	help
	  Includes gpio application
```

## base_external/package/aesd-socket/Config.in
```kconfig
config BR2_PACKAGE_AESD_SOCKET
	bool "aesd-socket"
	help
	  Includes socket application
```

## base_external/package/ldd/Config.in
```kconfig
config BR2_PACKAGE_LDD
	bool "ldd"
	help
	  Includes the scull and faulty module in the kernel image.
	  Used to understand buildroot external trees and package builds.
```
